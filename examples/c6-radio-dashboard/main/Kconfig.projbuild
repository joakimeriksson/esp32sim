## examples/c6-radio-dashboard/main/Kconfig.projbuild
```kconfig
menu "Radio dashboard"
config DASH_SSID
    string "Station SSID (empty = scan only)"
    default ""
config DASH_PASSWORD
    string "Station password (empty = open network)"
    default ""
config DASH_START_SPECTRUM
    bool "Start in 802.15.4 spectrum mode"
    default n
endmenu
```

## examples/c6-radio-dashboard/sdkconfig.defaults
```kconfig
CONFIG_IDF_TARGET="esp32c6"
CONFIG_ESPTOOLPY_FLASHSIZE_4MB=y
CONFIG_ESP_CONSOLE_USB_SERIAL_JTAG=y
CONFIG_FREERTOS_HZ=1000
CONFIG_LV_COLOR_DEPTH_16=y
CONFIG_LV_COLOR_16_SWAP=y
CONFIG_ESP_MAIN_TASK_STACK_SIZE=6144
CONFIG_COMPILER_OPTIMIZATION_SIZE=y
CONFIG_LV_FONT_MONTSERRAT_12=y
CONFIG_LV_FONT_DEFAULT_MONTSERRAT_12=y
```

## examples/c6-wifi-station/main/Kconfig.projbuild
```kconfig
menu "C6 WiFi station"
config STATION_SSID
    string "SSID to join (empty = scan only)"
    default "esp32sim"
    help
        The default is the emulator's virtual access point. Set your own network here for
        the real board; it lives in the ignored sdkconfig.
config STATION_PASSWORD
    string "WPA2 passphrase (empty = open network)"
    default "esp32sim-pass"
config STATION_PING_COUNT
    int "Gateway pings after the lease"
    default 5
    range 0 100
config STATION_LCD
    bool "Show the state on the board's ST7789 (Waveshare ESP32-C6-LCD-1.47)"
    default y
    help
        Plain text, no LVGL: one SPI transfer per changed line. Turn it off for register
        traces, so the only peripheral traffic is WiFi's.
config STATION_LCD_FLIP
    bool "Rotate the text 180 degrees"
    depends on STATION_LCD
    default n
endmenu
```

## examples/c6-wifi-station/sdkconfig.defaults
```kconfig
CONFIG_IDF_TARGET="esp32c6"
CONFIG_ESPTOOLPY_FLASHSIZE_4MB=y
CONFIG_PARTITION_TABLE_SINGLE_APP_LARGE=y
CONFIG_ESP_CONSOLE_USB_SERIAL_JTAG=y
CONFIG_ESP_WIFI_SOFTAP_SUPPORT=n
```

## examples/esp-hosted-p4/station/sdkconfig.defaults
```kconfig
CONFIG_ESP_WIFI_SOFTAP_SUPPORT=n

CONFIG_IDF_TARGET="esp32p4"
CONFIG_ESP32P4_REV_MIN_100=y
CONFIG_ESP32P4_SELECTS_REV_LESS_V3=y
CONFIG_ESP_WIFI_SSID="esp32sim"
CONFIG_ESP_WIFI_PASSWORD="esp32sim-pass"
```
